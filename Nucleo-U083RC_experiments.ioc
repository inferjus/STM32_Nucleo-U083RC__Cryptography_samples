# file: Nucleo-U083RC_experiments.ioc
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AES.Algorithm=CRYP_AES_CBC
AES.DataType=CRYP_DATATYPE_8B
AES.DataWidthUnit=CRYP_DATAWIDTHUNIT_BYTE
AES.HeaderWidthUnit=CRYP_HEADERWIDTHUNIT_BYTE
AES.KeyIVConfigSkip=CRYP_KEYIVCONFIG_ALWAYS
AES.pInitVect=00010203 04050607 08090A0B 0C0D0E0F
AES.pKey=2B7E1516 28AED2A6 ABF71588 09CF4F3C
Dma.AES_IN.0.Direction=DMA_MEMORY_TO_PERIPH
Dma.AES_IN.0.EventEnable=DISABLE
Dma.AES_IN.0.Instance=DMA1_Channel1
Dma.AES_IN.0.MemDataAlignment=DMA_MDATAALIGN_WORD
Dma.AES_IN.0.MemInc=DMA_MINC_ENABLE
Dma.AES_IN.0.Mode=DMA_NORMAL
Dma.AES_IN.0.PeriphDataAlignment=DMA_PDATAALIGN_WORD
Dma.AES_IN.0.PeriphInc=DMA_PINC_DISABLE
Dma.AES_IN.0.Polarity=HAL_DMAMUX_REQ_GEN_RISING
Dma.AES_IN.0.Priority=DMA_PRIORITY_LOW
Dma.AES_IN.0.RequestNumber=1
Dma.AES_IN.0.SignalID=NONE
Dma.AES_IN.0.SyncEnable=DISABLE
Dma.AES_IN.0.SyncPolarity=HAL_DMAMUX_SYNC_NO_EVENT
Dma.AES_IN.0.SyncRequestNumber=1
Dma.AES_IN.0.SyncSignalID=NONE
Dma.AES_OUT.1.Direction=DMA_PERIPH_TO_MEMORY
Dma.AES_OUT.1.EventEnable=DISABLE
Dma.AES_OUT.1.Instance=DMA1_Channel2
Dma.AES_OUT.1.MemDataAlignment=DMA_MDATAALIGN_WORD
Dma.AES_OUT.1.MemInc=DMA_MINC_ENABLE
Dma.AES_OUT.1.Mode=DMA_NORMAL
Dma.AES_OUT.1.PeriphDataAlignment=DMA_PDATAALIGN_WORD
Dma.AES_OUT.1.PeriphInc=DMA_PINC_DISABLE
Dma.AES_OUT.1.Polarity=HAL_DMAMUX_REQ_GEN_RISING
Dma.AES_OUT.1.Priority=DMA_PRIORITY_LOW
Dma.AES_OUT.1.RequestNumber=1
Dma.AES_OUT.1.SignalID=NONE
Dma.AES_OUT.1.SyncEnable=DISABLE
Dma.AES_OUT.1.SyncPolarity=HAL_DMAMUX_SYNC_NO_EVENT
Dma.AES_OUT.1.SyncRequestNumber=1
Dma.AES_OUT.1.SyncSignalID=NONE
Dma.Request0=AES_IN
Dma.Request1=AES_OUT
Mcu.Family=STM32U0
Mcu.Name=STM32U083RCTx
Mcu.Package=LQFP64
NUCLEO-U083RC.BUTTON=1
NUCLEO-U083RC.Bsp_Common_DEMO=true
NUCLEO-U083RC.LD4=true
NUCLEO-U083RC.VCP=true
NVIC.DMA1_Channel1_IRQn=true\:0\:0\:false\:false\:true\:false\:true\:true
NVIC.DMA1_Channel2_3_IRQn=true\:0\:0\:false\:false\:true\:false\:true\:true
NVIC.EXTI4_15_IRQn=true\:0\:0\:false\:false\:true\:false\:true\:true
NVIC.PriorityGroup=NVIC_PRIORITYGROUP_2
NVIC.RNG_CRYP_IRQn=true\:0\:0\:false\:false\:true\:true\:true\:true
PA13\ (SWDIO).GPIO_Label=SWDIO
PA13\ (SWDIO).Signal=DEBUG_JTMS-SWDIO
PA14\ (SWCLK).GPIO_Label=SWCLK
PA14\ (SWCLK).Signal=DEBUG_JTCK-SWCLK
PA2.Signal=USART2_TX
PA3.Signal=USART2_RX
PC14-OSC32_IN.GPIO_Label=OSC32_IN
PC14-OSC32_IN.Mode=LSE-External-Oscillator
PC14-OSC32_IN.Signal=RCC_OSC32_IN
PC15-OSC32_OUT.GPIO_Label=OSC32_OUT
PC15-OSC32_OUT.Mode=LSE-External-Oscillator
PC15-OSC32_OUT.Signal=RCC_OSC32_OUT
PF0-OSC_IN.GPIO_Label=OSC_IN
PF0-OSC_IN.Signal=RCC_OSC_IN
PF1-OSC_OUT.GPIO_Label=OSC_OUT
PF1-OSC_OUT.Signal=RCC_OSC_OUT
ProjectManager.HeapSize=0x200
ProjectManager.StackSize=0x400
ProjectManager.TargetToolchain=STM32CubeIDE
RCC.ADCFreq_Value=56000000
RCC.AHBFreq_Value=56000000
RCC.CortexFreq_Value=56000000
RCC.HCLKFreq_Value=56000000
RCC.HSE_VALUE=4000000
RCC.HSI48_VALUE=48000000
RCC.HSI_VALUE=16000000
RCC.MSIClockRangeVal=RCC_MSIRANGE_11
RCC.MSI_VALUE=48000000
RCC.PLLN=7
RCC.RNGCLockSelection=RCC_RNGCLKSOURCE_HSI48
RCC.SYSCLKFreq_VALUE=56000000
RCC.SYSCLKSource=RCC_SYSCLKSOURCE_PLLCLK
RCC.USBFreq_Value=48000000
RCC.VCOOutputFreq_Value=112000000
VP_AES_VS_AES.Mode=AES_Activate
VP_NUCLEO-U083RC_VS_BSP_COMMON.Mode=COMMON
VP_PWR_VS_SECSignals.Mode=Security/Privilege
VP_RNG_VS_RNG.Mode=RNG_Activate
board=NUCLEO-U083RC

// file: Core/Src/main.c
/* USER CODE BEGIN Header */
/**
  ******************************************************************************
  * @file           : main.c
  * @brief          : Main program body
  ******************************************************************************
  * @attention
  *
  * Copyright (c) 2026 STMicroelectronics.
  * All rights reserved.
  *
  * This software is licensed under terms that can be found in the LICENSE file
  * in the root directory of this software component.
  * If no LICENSE file comes with this software, it is provided AS-IS.
  *
  ******************************************************************************
  */
/* USER CODE END Header */
#include "main.h"
#include "aes.h"
#include "dma.h"
#include "rng.h"
#include "gpio.h"

COM_InitTypeDef BspCOMInit;
__IO uint32_t BspButtonState = BUTTON_RELEASED;

/* USER CODE BEGIN PV */
#define AES_BUF_SIZE 32
uint8_t plaintext[AES_BUF_SIZE] = "STM32U0 plaintext .";
uint8_t cipherOutput[AES_BUF_SIZE] = { 0 };
uint8_t decryptedData[AES_BUF_SIZE] = { 0 };
/* USER CODE END PV */

void SystemClock_Config(void);

int main(void)
{

  /* MCU Configuration--------------------------------------------------------*/

  /* Reset of all peripherals, Initializes the Flash interface and the Systick. */
  HAL_Init();

  /* Configure the system clock */
  SystemClock_Config();

  /* Initialize all configured peripherals */
  MX_GPIO_Init();
  MX_DMA_Init();
  MX_AES_Init();
  MX_RNG_Init();

  /* Initialize leds */
  BSP_LED_Init(LED_GREEN);

  /* Initialize USER push-button, will be used to trigger an interrupt each time it's pressed.*/
  BSP_PB_Init(BUTTON_USER, BUTTON_MODE_EXTI);

  /* Initialize COM1 port (115200, 8 bits (7-bit data + 1 stop bit), no parity */
  BspCOMInit.BaudRate   = 115200;
  BspCOMInit.WordLength = COM_WORDLENGTH_8B;
  BspCOMInit.StopBits   = COM_STOPBITS_1;
  BspCOMInit.Parity     = COM_PARITY_NONE;
  BspCOMInit.HwFlowCtl  = COM_HWCONTROL_NONE;
  if (BSP_COM_Init(COM1, &BspCOMInit) != BSP_ERROR_NONE)
  {
    Error_Handler();
  }

  /* USER CODE BEGIN BSP */

  /* -- Sample board code to send message over COM1 port ---- */
  printf("Welcome to STM32 world !\r\n");

  /* -- Sample board code to switch on leds ---- */
  BSP_LED_On(LED_GREEN);

  /* USER CODE END BSP */

  /* Infinite loop */
  /* USER CODE BEGIN WHILE */
  while (1) {

    /* -- Sample board code for User push-button in interrupt mode ---- */
    if (BspButtonState == BUTTON_PRESSED) {
      /* Update button state */
      BspButtonState = BUTTON_RELEASED;
      /* -- Sample board code to toggle leds ---- */
      BSP_LED_Toggle(LED_GREEN);

#ifndef RNG_VIA_INTERRUPT
      randomSeed=Security_GetRandomSeed();
#else
      randomSeedReady = 0;
      Security_GetRandomSeed_IT();
#endif

#ifndef AES_VIA_DMA
      printf("\r\n");
      printf("plaintext:%s\r\n", plaintext);
      SecureComms_EncryptPayload((uint32_t *)plaintext, sizeof(plaintext), (uint32_t *)cipherOutput);
      printf("cipherOutput:%s\r\n", cipherOutput);
      SecureComms_DecryptPayload((uint32_t *)cipherOutput, (uint32_t *)decryptedData, sizeof(decryptedData));
      printf("decryptedData:%s\r\n", decryptedData);
      printf("\r\n");
#else
	switch (aesDmaState) {
	case AES_DMA_OFF:
		printf("\r\n");
		printf("plaintext:%s\r\n", plaintext);
		SecureComms_EncryptPayload_DMA((uint32_t*) plaintext, sizeof(plaintext), (uint32_t*) cipherOutput);
		break;
	default:
		break;
	}

#endif

    }

#ifdef AES_VIA_DMA
	switch (aesDmaState) {
	case AES_DMA_ENCRYPTED:
		printf("cipherOutput:%s\r\n", cipherOutput);
		SecureComms_DecryptPayload_DMA((uint32_t*) cipherOutput, (uint32_t*) decryptedData, sizeof(decryptedData));
		break;
	case AES_DMA_DECRYPTED:
		printf("decryptedData:%s\r\n", decryptedData);
		printf("\r\n");
		aesDmaState = AES_DMA_OFF;
		break;
	default:
		break;
	}
#endif

#ifdef RNG_VIA_INTERRUPT
    if (randomSeedReady == 1) {
	  randomSeedReady = 0;
	  printf("Wygenerowano seed: %lu\r\n", randomSeed);
	  printf("\r\n\r\n");
	}
#endif

    /* USER CODE END WHILE */

  }
}

void SystemClock_Config(void)
{
  RCC_OscInitTypeDef RCC_OscInitStruct = {0};
  RCC_ClkInitTypeDef RCC_ClkInitStruct = {0};

  /** Configure the main internal regulator output voltage
  */
  HAL_PWREx_ControlVoltageScaling(PWR_REGULATOR_VOLTAGE_SCALE1);

  /** Initializes the RCC Oscillators according to the specified parameters
  * in the RCC_OscInitTypeDef structure.
  */
  RCC_OscInitStruct.OscillatorType = RCC_OSCILLATORTYPE_HSI|RCC_OSCILLATORTYPE_HSI48
                              |RCC_OSCILLATORTYPE_MSI;
  RCC_OscInitStruct.HSIState = RCC_HSI_ON;
  RCC_OscInitStruct.HSICalibrationValue = RCC_HSICALIBRATION_DEFAULT;
  RCC_OscInitStruct.MSIState = RCC_MSI_ON;
  RCC_OscInitStruct.MSICalibrationValue = RCC_MSICALIBRATION_DEFAULT;
  RCC_OscInitStruct.MSIClockRange = RCC_MSIRANGE_11;
  RCC_OscInitStruct.HSI48State = RCC_HSI48_ON;
  RCC_OscInitStruct.PLL.PLLState = RCC_PLL_ON;
  RCC_OscInitStruct.PLL.PLLSource = RCC_PLLSOURCE_HSI;
  RCC_OscInitStruct.PLL.PLLM = RCC_PLLM_DIV1;
  RCC_OscInitStruct.PLL.PLLN = 7;
  RCC_OscInitStruct.PLL.PLLP = RCC_PLLP_DIV2;
  RCC_OscInitStruct.PLL.PLLQ = RCC_PLLQ_DIV2;
  RCC_OscInitStruct.PLL.PLLR = RCC_PLLR_DIV2;
  if (HAL_RCC_OscConfig(&RCC_OscInitStruct) != HAL_OK)
  {
    Error_Handler();
  }

  /** Initializes the CPU, AHB and APB buses clocks
  */
  RCC_ClkInitStruct.ClockType = RCC_CLOCKTYPE_HCLK|RCC_CLOCKTYPE_SYSCLK
                              |RCC_CLOCKTYPE_PCLK1;
  RCC_ClkInitStruct.SYSCLKSource = RCC_SYSCLKSOURCE_PLLCLK;
  RCC_ClkInitStruct.AHBCLKDivider = RCC_SYSCLK_DIV1;
  RCC_ClkInitStruct.APB1CLKDivider = RCC_HCLK_DIV1;

  if (HAL_RCC_ClockConfig(&RCC_ClkInitStruct, FLASH_LATENCY_2) != HAL_OK)
  {
    Error_Handler();
  }
}

/**
  * @brief  BSP Push Button callback
  * @param  Button Specifies the pressed button
  * @retval None
  */
void BSP_PB_Callback(Button_TypeDef Button)
{
  if (Button == BUTTON_USER)
  {
    BspButtonState = BUTTON_PRESSED;
  }
}

void Error_Handler(void)
{
  __disable_irq();
  while (1)
  {
  }
}
